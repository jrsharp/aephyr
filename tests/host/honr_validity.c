/*
 * Copyright (c) 2026 Æther Authors
 *
 * SPDX-License-Identifier: MIT
 *
 * Host validity test for honr_is_valid_node(). Cross-checks the predicate
 * against an independent definition: the set of valid node addresses is
 * generated by construction (every left-justified path of child nibbles 1..14,
 * depth 0..4), and every one of the 65536 addresses is checked to agree. Also
 * verifies the math preserves validity (parent of a valid address is valid and
 * one rank shallower). No Zephyr, no hardware.
 *
 * Build & run (from the repo root):
 *   cc -I include/zephyr/net -Wall -Wextra tests/host/honr_validity.c -o /tmp/v && /tmp/v
 */

#include <stdio.h>
#include <stdlib.h>
#include "honr.h"

static char generated[0x10000]; /* 1 = reachable by constructing a valid path */

/* Independent definition: enumerate every valid node address by construction. */
static void generate(uint16_t prefix, unsigned int depth)
{
	generated[prefix] = 1;
	if (depth == HONR_NIBBLES) {
		return;
	}
	for (uint8_t c = HONR_CHILD_MIN; c <= HONR_CHILD_MAX; c++) {
		generate(honr_set_nibble(prefix, depth, c), depth + 1);
	}
}

int main(void)
{
	long valid_count = 0, mismatches = 0, preserve_fail = 0;

	generate(HONR_ROOT, 0);

	for (long a = 0; a <= 0xFFFF; a++) {
		uint16_t addr = (uint16_t)a;
		int pred = honr_is_valid_node(addr) ? 1 : 0;
		int ref = generated[addr] ? 1 : 0;

		if (pred != ref) {
			if (mismatches < 5) {
				printf("  MISMATCH %04x: predicate=%d constructed=%d\n",
				       addr, pred, ref);
			}
			mismatches++;
		}
		if (!pred) {
			continue;
		}
		valid_count++;

		/* Validity must be preserved by the parent relation. */
		if (!honr_is_root(addr)) {
			uint16_t p = honr_parent(addr);

			if (!honr_is_valid_node(p) ||
			    honr_rank(p) != honr_rank(addr) - 1 ||
			    !honr_is_ancestor(p, addr)) {
				preserve_fail++;
			}
		}
	}

	/* Independent count: sum_{d=0}^{4} 14^d = 1+14+196+2744+38416 = 41371. */
	long expected = 1 + 14 + 196 + 2744 + 38416;

	printf("honr_is_valid_node over all 65536 addresses:\n");
	printf("  valid=%ld (expected %ld)  predicate/construction mismatches=%ld  "
	       "parent-preserve failures=%ld\n",
	       valid_count, expected, mismatches, preserve_fail);

	int ok = (mismatches == 0) && (preserve_fail == 0) && (valid_count == expected);

	printf("%s\n", ok ? "PASS: validator matches construction; validity preserved"
			  : "FAILED");
	return ok ? 0 : 1;
}
