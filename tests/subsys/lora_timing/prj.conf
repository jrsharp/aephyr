## CMakeLists.txt
```
# SPDX-License-Identifier: MIT

cmake_minimum_required(VERSION 3.20.0)
find_package(Zephyr REQUIRED HINTS $ENV{ZEPHYR_BASE})
project(lora_timing_test)

target_sources(app PRIVATE src/main.c)
```

## prj.conf
```kconfig
# Test configuration
CONFIG_ZTEST=y
CONFIG_LOG=y
CONFIG_LOG_DEFAULT_LEVEL=3

# For floating point printf
CONFIG_CBPRINTF_FP_SUPPORT=y

# Random number generation (for backoff tests)
CONFIG_ENTROPY_GENERATOR=y
CONFIG_TEST_RANDOM_GENERATOR=y
```

## src/main.c
```c
/*
 * Copyright (c) 2025 Æther Authors
 *
 * SPDX-License-Identifier: MIT
 *
 * LoRa timing tests - validates time-on-air calculations, duty cycle
 * tracking, and collision avoidance logic against SX126x datasheet values.
 */

#include <zephyr/ztest.h>
#include <zephyr/random/random.h>
#include <string.h>
#include <math.h>

/* LoRa parameters */
#define LORA_SF_7   7
#define LORA_SF_8   8
#define LORA_SF_9   9
#define LORA_SF_10  10
#define LORA_SF_11  11
#define LORA_SF_12  12

#define LORA_BW_125_KHZ  125000
#define LORA_BW_250_KHZ  250000
#define LORA_BW_500_KHZ  500000

#define LORA_CR_4_5  1  /* 4/5 coding rate */
#define LORA_CR_4_6  2  /* 4/6 coding rate */
#define LORA_CR_4_7  3  /* 4/7 coding rate */
#define LORA_CR_4_8  4  /* 4/8 coding rate */

/* Duty cycle limits (1% for 915 MHz ISM band in US) */
#define DUTY_CYCLE_LIMIT_PERCENT  1
#define DUTY_CYCLE_WINDOW_MS      3600000  /* 1 hour window */

/*
 * LoRa time-on-air calculation
 * Based on SX1262 datasheet formulas (DS.SX1261-2.W.APP, Rev 2.1)
 *
 * Parameters:
 *   sf       - Spreading factor (7-12)
 *   bw       - Bandwidth in Hz (125000, 250000, 500000)
 *   cr       - Coding rate (1=4/5, 2=4/6, 3=4/7, 4=4/8)
 *   preamble - Preamble symbols (typically 8)
 *   payload  - Payload length in bytes
 *   crc      - CRC enabled (true/false)
 *   implicit - Implicit header mode (true/false)
 *
 * Returns: Time-on-air in milliseconds
 */
static uint32_t lora_time_on_air_ms(uint8_t sf, uint32_t bw, uint8_t cr,
                                     uint8_t preamble, uint8_t payload,
                                     bool crc, bool implicit)
{
	/* Symbol time in microseconds: T_sym = (2^SF / BW) * 1e6 */
	uint32_t t_sym_us = ((1UL << sf) * 1000000UL) / bw;

	/* Low data rate optimization: required for SF11/SF12 @ 125kHz */
	uint8_t de = ((sf >= 11) && (bw == LORA_BW_125_KHZ)) ? 1 : 0;

	/* Header mode: 0 = explicit header, 1 = implicit (no header) */
	uint8_t ih = implicit ? 1 : 0;

	/* CRC: 16 bits if enabled */
	uint8_t crc_bits = crc ? 16 : 0;

	/* Preamble time: (n_preamble + 4.25) * T_sym */
	/* Using fixed-point: 4.25 = 17/4, so multiply by 4, add 17, divide by 4 */
	uint32_t preamble_time_us = ((preamble * 4 + 17) * t_sym_us) / 4;

	/* Payload symbol calculation from SX1262 datasheet */
	/* n_payload = 8 + max(ceil((8*PL - 4*SF + 28 + 16*CRC - 20*IH) / (4*(SF-2*DE))) * (CR+4), 0) */
	int32_t numerator = 8 * payload - 4 * sf + 28 + crc_bits - 20 * ih;
	int32_t denominator = 4 * (sf - 2 * de);

	uint32_t payload_symbols;
	if (numerator <= 0) {
		payload_symbols = 8;
	} else {
		/* Ceiling division */
		int32_t ceil_div = (numerator + denominator - 1) / denominator;
		payload_symbols = 8 + ceil_div * (cr + 4);
	}

	/* Payload time */
	uint32_t payload_time_us = payload_symbols * t_sym_us;

	/* Total time on air */
	uint32_t total_us = preamble_time_us + payload_time_us;

	/* Convert to milliseconds (round up) */
	return (total_us + 999) / 1000;
}

/*
 * Duty cycle tracker
 */
struct duty_cycle_tracker {
	uint32_t window_start_ms;
	uint32_t total_tx_time_ms;
	uint32_t limit_percent;
};

static void duty_cycle_init(struct duty_cycle_tracker *tracker, uint32_t limit_percent)
{
	tracker->window_start_ms = 0;
	tracker->total_tx_time_ms = 0;
	tracker->limit_percent = limit_percent;
}

static bool duty_cycle_can_transmit(struct duty_cycle_tracker *tracker,
                                     uint32_t current_ms, uint32_t tx_time_ms)
{
	/* Check if we've moved to a new window */
	if (current_ms - tracker->window_start_ms >= DUTY_CYCLE_WINDOW_MS) {
		tracker->window_start_ms = current_ms;
		tracker->total_tx_time_ms = 0;
	}

	/* Calculate maximum allowed TX time */
	uint32_t max_tx_ms = (DUTY_CYCLE_WINDOW_MS * tracker->limit_percent) / 100;

	/* Check if this transmission would exceed the limit */
	return (tracker->total_tx_time_ms + tx_time_ms) <= max_tx_ms;
}

static void duty_cycle_record_tx(struct duty_cycle_tracker *tracker, uint32_t tx_time_ms)
{
	tracker->total_tx_time_ms += tx_time_ms;
}

/*
 * Simple CSMA/CA backoff calculator
 * Returns backoff time in milliseconds
 */
static uint32_t csma_ca_backoff_ms(uint8_t attempt, uint32_t slot_time_ms,
                                    uint8_t min_be, uint8_t max_be)
{
	/* Binary exponential backoff */
	uint8_t be = min_be + attempt;
	if (be > max_be) {
		be = max_be;
	}

	/* Random number of slots: 0 to (2^BE - 1) */
	uint32_t max_slots = (1U << be) - 1;
	uint32_t slots = sys_rand32_get() % (max_slots + 1);

	return slots * slot_time_ms;
}

/*
 * Test: Time-on-air calculation for typical chat message
 *
 * Using SF10, BW125, CR4/5 with 30-byte payload (typical short message)
 * Expected: ~370ms (verified against Semtech calculator)
 */
ZTEST(lora_timing, test_toa_chat_message)
{
	/* Typical chat message parameters */
	uint32_t toa = lora_time_on_air_ms(
		LORA_SF_10,      /* SF10 */
		LORA_BW_125_KHZ, /* 125 kHz */
		LORA_CR_4_5,     /* 4/5 coding rate */
		8,               /* 8 preamble symbols */
		30,              /* 30-byte payload (HeyMac + Aether + short message) */
		true,            /* CRC enabled */
		false            /* Explicit header */
	);

	/* SF10 @ 125kHz should give ~400-500ms for 30 bytes */
	/* Calculated: symbol time = 8.192ms, ~55 symbols total */
	zassert_true(toa >= 350 && toa <= 500,
		     "ToA for 30-byte SF10 message: %u ms (expected 350-500)", toa);

	printk("30-byte chat message @ SF10/BW125: %u ms\n", toa);
}

/*
 * Test: Time-on-air for HeyMac beacon (minimal frame)
 */
ZTEST(lora_timing, test_toa_beacon)
{
	/* Beacon: HeyMac header only (~11 bytes) */
	uint32_t toa = lora_time_on_air_ms(
		LORA_SF_10,
		LORA_BW_125_KHZ,
		LORA_CR_4_5,
		8,
		11,   /* Minimal HeyMac beacon */
		true,
		false
	);

	/* Should be shorter than data message */
	zassert_true(toa >= 200 && toa <= 350,
		     "Beacon ToA: %u ms (expected 200-350)", toa);

	printk("11-byte beacon @ SF10/BW125: %u ms\n", toa);
}

/*
 * Test: Time-on-air scales correctly with SF
 */
ZTEST(lora_timing, test_toa_sf_scaling)
{
	uint32_t toa_sf7 = lora_time_on_air_ms(LORA_SF_7, LORA_BW_125_KHZ,
					       LORA_CR_4_5, 8, 20, true, false);
	uint32_t toa_sf10 = lora_time_on_air_ms(LORA_SF_10, LORA_BW_125_KHZ,
						LORA_CR_4_5, 8, 20, true, false);
	uint32_t toa_sf12 = lora_time_on_air_ms(LORA_SF_12, LORA_BW_125_KHZ,
						LORA_CR_4_5, 8, 20, true, false);

	/* Each SF increase roughly doubles symbol time */
	/* SF10 should be ~8x longer than SF7 */
	zassert_true(toa_sf10 > toa_sf7 * 4,
		     "SF10 (%u) should be much longer than SF7 (%u)", toa_sf10, toa_sf7);

	/* SF12 should be ~4x longer than SF10 */
	zassert_true(toa_sf12 > toa_sf10 * 2,
		     "SF12 (%u) should be much longer than SF10 (%u)", toa_sf12, toa_sf10);

	printk("20-byte ToA: SF7=%u ms, SF10=%u ms, SF12=%u ms\n",
	       toa_sf7, toa_sf10, toa_sf12);
}

/*
 * Test: Known values from SX1262 datasheet / Semtech calculator
 *
 * Reference: SF7, BW125, CR4/5, 8 preamble, 10 bytes, CRC on, explicit header
 * Expected: ~41ms (from Semtech LoRa Calculator)
 */
ZTEST(lora_timing, test_toa_known_values_sf7)
{
	uint32_t toa = lora_time_on_air_ms(
		LORA_SF_7,
		LORA_BW_125_KHZ,
		LORA_CR_4_5,
		8,
		10,
		true,
		false
	);

	/* Semtech calculator gives 41.216ms for these parameters */
	/* Allow 10% tolerance for rounding */
	zassert_true(toa >= 37 && toa <= 46,
		     "SF7 10-byte ToA: %u ms (expected ~41)", toa);

	printk("10-byte @ SF7/BW125 (datasheet reference): %u ms\n", toa);
}

/*
 * Test: Known values SF12 (longest air time)
 *
 * Reference: SF12, BW125, CR4/5, 8 preamble, 10 bytes, CRC on, explicit header
 * Expected: ~991ms (from Semtech LoRa Calculator)
 */
ZTEST(lora_timing, test_toa_known_values_sf12)
{
	uint32_t toa = lora_time_on_air_ms(
		LORA_SF_12,
		LORA_BW_125_KHZ,
		LORA_CR_4_5,
		8,
		10,
		true,
		false
	);

	/* Semtech calculator gives ~991ms for these parameters */
	/* Allow 10% tolerance */
	zassert_true(toa >= 890 && toa <= 1100,
		     "SF12 10-byte ToA: %u ms (expected ~991)", toa);

	printk("10-byte @ SF12/BW125 (datasheet reference): %u ms\n", toa);
}

/*
 * Test: Duty cycle enforcement (1% limit)
 */
ZTEST(lora_timing, test_duty_cycle_limit)
{
	struct duty_cycle_tracker tracker;
	duty_cycle_init(&tracker, DUTY_CYCLE_LIMIT_PERCENT);

	uint32_t current_time = 0;
	uint32_t msg_time = 400;  /* 400ms per message */

	/* 1% of 1 hour = 36000ms = 36 seconds of TX time */
	/* Should allow ~90 messages of 400ms each */

	int tx_count = 0;
	while (duty_cycle_can_transmit(&tracker, current_time, msg_time)) {
		duty_cycle_record_tx(&tracker, msg_time);
		tx_count++;

		/* Don't go forever */
		if (tx_count > 100) break;
	}

	/* Should allow 90 messages (36000ms / 400ms = 90) */
	zassert_true(tx_count >= 85 && tx_count <= 95,
		     "Should allow ~90 messages at 1%% duty cycle, got %d", tx_count);

	printk("Duty cycle test: %d messages allowed (400ms each, 1%% limit)\n", tx_count);
}

/*
 * Test: Duty cycle window reset
 */
ZTEST(lora_timing, test_duty_cycle_window_reset)
{
	struct duty_cycle_tracker tracker;
	duty_cycle_init(&tracker, DUTY_CYCLE_LIMIT_PERCENT);

	/* Exhaust duty cycle */
	uint32_t current_time = 0;
	for (int i = 0; i < 90; i++) {
		if (duty_cycle_can_transmit(&tracker, current_time, 400)) {
			duty_cycle_record_tx(&tracker, 400);
		}
	}

	/* Should be at or near limit */
	zassert_false(duty_cycle_can_transmit(&tracker, current_time, 400),
		      "Should be at duty cycle limit");

	/* Advance time by 1 hour (new window) */
	current_time += DUTY_CYCLE_WINDOW_MS;

	/* Should be able to transmit again */
	zassert_true(duty_cycle_can_transmit(&tracker, current_time, 400),
		     "Should reset after window period");
}

/*
 * Test: CSMA/CA backoff distribution
 */
ZTEST(lora_timing, test_csma_backoff_distribution)
{
	/* Slot time based on SF10 symbol time (~8ms) */
	uint32_t slot_time = 10;  /* 10ms slots */
	uint32_t min_be = 3;      /* Minimum backoff exponent */
	uint32_t max_be = 5;      /* Maximum backoff exponent */

	/* Test first attempt (BE=3, max 7 slots) */
	uint32_t min_backoff = UINT32_MAX;
	uint32_t max_backoff = 0;
	uint32_t total = 0;

	for (int i = 0; i < 100; i++) {
		uint32_t backoff = csma_ca_backoff_ms(0, slot_time, min_be, max_be);
		if (backoff < min_backoff) min_backoff = backoff;
		if (backoff > max_backoff) max_backoff = backoff;
		total += backoff;
	}

	/* BE=3 means 0-7 slots, so 0-70ms */
	zassert_true(min_backoff >= 0 && min_backoff <= 10,
		     "Min backoff should be near 0, got %u", min_backoff);
	zassert_true(max_backoff >= 50 && max_backoff <= 70,
		     "Max backoff should be near 70ms, got %u", max_backoff);

	printk("Backoff attempt 0: min=%u ms, max=%u ms, avg=%u ms\n",
	       min_backoff, max_backoff, total / 100);

	/* Test later attempt (BE capped at max_be=5, max 31 slots) */
	min_backoff = UINT32_MAX;
	max_backoff = 0;
	total = 0;

	for (int i = 0; i < 100; i++) {
		uint32_t backoff = csma_ca_backoff_ms(5, slot_time, min_be, max_be);
		if (backoff < min_backoff) min_backoff = backoff;
		if (backoff > max_backoff) max_backoff = backoff;
		total += backoff;
	}

	/* BE=5 means 0-31 slots, so 0-310ms */
	zassert_true(max_backoff >= 200 && max_backoff <= 310,
		     "Max backoff at BE=5 should be ~310ms, got %u", max_backoff);

	printk("Backoff attempt 5 (capped): min=%u ms, max=%u ms, avg=%u ms\n",
	       min_backoff, max_backoff, total / 100);
}

/*
 * Test: Collision window calculation
 *
 * Two nodes transmitting simultaneously should detect collision
 * if their transmissions overlap within the symbol time.
 */
ZTEST(lora_timing, test_collision_window)
{
	/* Symbol time at SF10/BW125 = 2^10 / 125000 * 1000 = 8.192ms */
	uint32_t symbol_time_ms = 8;  /* Rounded for test */

	/* Message time-on-air */
	uint32_t toa = lora_time_on_air_ms(LORA_SF_10, LORA_BW_125_KHZ,
					   LORA_CR_4_5, 8, 30, true, false);

	/* Collision window: must not transmit within (toa + symbol_time) of another TX */
	uint32_t collision_window = toa + symbol_time_ms;

	printk("Collision window for 30-byte message: %u ms (toa=%u + sym=%u)\n",
	       collision_window, toa, symbol_time_ms);

	/* For chat app: random delay should exceed collision window */
	/* With 90 possible messages/hour and random timing, collision probability is low */
	/* But we should still use listen-before-talk where possible */

	zassert_true(collision_window > 300 && collision_window < 500,
		     "Collision window should be ~350-400ms for SF10");
}

/*
 * Test: Maximum message rate at 1% duty cycle
 */
ZTEST(lora_timing, test_max_message_rate)
{
	/* Calculate max messages per hour at 1% duty cycle */
	uint32_t toa = lora_time_on_air_ms(LORA_SF_10, LORA_BW_125_KHZ,
					   LORA_CR_4_5, 8, 50, true, false);

	/* 1% of 3600 seconds = 36 seconds = 36000ms */
	uint32_t max_tx_time_ms = 36000;
	uint32_t max_messages = max_tx_time_ms / toa;

	printk("Max messages per hour (50-byte @ SF10): %u (toa=%u ms each)\n",
	       max_messages, toa);

	/* Should be able to send reasonable number of chat messages */
	/* At ~400ms per message, that's ~90 messages/hour */
	zassert_true(max_messages >= 50 && max_messages <= 150,
		     "Should allow 50-150 messages/hour at 1%% duty cycle");
}

ZTEST_SUITE(lora_timing, NULL, NULL, NULL, NULL, NULL);
```
