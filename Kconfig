## dts/bindings/net/aether-mesh-net.yaml
```yaml
# SPDX-License-Identifier: MIT

description: Æther Mesh Network Configuration

compatible: "aether-mesh-net"

properties:
  network-id:
    type: int
    description: HeyMac network identifier
    default: 0x915E

  mesh-network-id:
    type: int
    description: Æther mesh network identifier (optional)

  node-id:
    type: int
    description: Node identifier for this device

  mesh-enabled:
    type: boolean
    description: Enable mesh networking features

  max-hops:
    type: int
    description: Maximum hop count for mesh packets
    default: 6

  hello-interval:
    type: int
    description: Hello message interval in seconds
    default: 30

  route-timeout:
    type: int
    description: Route timeout in seconds
    default: 300

  neighbor-timeout:
    type: int
    description: Neighbor timeout in seconds
    default: 90

  sleep-enabled:
    type: boolean
    description: Enable power management features

  beacon-interval:
    type: int
    description: Beacon interval in milliseconds (for coordinators)
    default: 1000

  use-short-addr:
    type: boolean
    description: Use 2-byte short addresses instead of 6-byte long addresses
    default: true

  conditional-net-id:
    type: boolean
    description: Enable conditional mesh network ID optimization
    default: true
```

## subsys/net/l2/uart/Kconfig
```kconfig
# SPDX-License-Identifier: MIT

menuconfig AETHER_UART
	bool "Aether UART L2 transport"
	depends on SERIAL
	depends on NETWORKING
	help
	  Enable Aether mesh networking over UART.
	  This provides a simple point-to-point transport for connecting
	  Aether mesh nodes via serial links. Useful for:
	  - Connecting to gateway devices
	  - Testing with QEMU virtual UARTs
	  - Wired backbone links between mesh segments

if AETHER_UART

config AETHER_UART_RX_STACK_SIZE
	int "RX thread stack size"
	default 1024
	help
	  Stack size for the UART receive thread.

config AETHER_UART_RX_THREAD_PRIO
	int "RX thread priority"
	default 7
	help
	  Priority for the UART receive thread.

config AETHER_UART_LOG_LEVEL
	int "Aether UART log level"
	default 3
	range 0 4
	help
	  Log level for the Aether UART L2 transport.
	  0=OFF, 1=ERR, 2=WRN, 3=INF, 4=DBG

endif # AETHER_UART
```

## tests/integration/loopback/testcase.yaml
```yaml
# SPDX-License-Identifier: MIT

tests:
  aether.integration.loopback:
    tags: aether integration
    platform_allow: qemu_x86
```

## tests/subsys/aether/testcase.yaml
```yaml
# SPDX-License-Identifier: MIT

tests:
  aether.mesh.header:
    tags: aether mesh
    platform_allow: qemu_x86
```

## tests/subsys/heymac/testcase.yaml
```yaml
# SPDX-License-Identifier: MIT

tests:
  aether.heymac.header:
    tags: aether heymac
    platform_allow: qemu_x86
```

## tests/subsys/honr/testcase.yaml
```yaml
# SPDX-License-Identifier: MIT

tests:
  aether.honr.addressing:
    tags: aether honr routing
    platform_allow:
      - qemu_x86
      - native_sim
```

## tests/subsys/lora_timing/testcase.yaml
```yaml
# SPDX-License-Identifier: MIT

tests:
  aether.lora.timing:
    tags: aether lora timing
    platform_allow: qemu_x86
```

## tests/subsys/svcdisc/testcase.yaml
```yaml
# SPDX-License-Identifier: MIT

tests:
  aether.svcdisc:
    tags: aether svcdisc
    platform_allow: native_sim qemu_x86
```

## west.yml
```yaml
# SPDX-License-Identifier: MIT

manifest:
  version: "1.0"
  
  defaults:
    remote: origin
    
  remotes:
    - name: origin
      url-base: https://github.com/jrsharp/aephyr
    - name: zephyrproject-rtos
      url-base: https://github.com/zephyrproject-rtos
      
  projects:
    - name: zephyr
      remote: zephyrproject-rtos
      revision: main
      import: true

  self:
    path: aephyr
```
